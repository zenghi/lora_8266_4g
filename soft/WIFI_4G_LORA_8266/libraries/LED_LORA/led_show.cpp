/******************************************************************************

 				 版权所有 (C), 2017-2027, 福州晴川科技有限公司

 ******************************************************************************
  文 件 名   : led_show.cpp
  版 本 号   : 初稿
  作    者   : zenghi
  联系方式 : 309966755@qq.com
  生成日期   : 2019-04-28
  功能描述   : LED显示模块，后续可以把led显示模块独立 先个独立的显示模块
******************************************************************************/
#include "led_show.h"
#include "lora_server.h"
#include "qc_telnet.h"
#include "AT_4G.h"
#define USE_SERIAL telnet//Serial
#define LED_PIN 2

/*************************************************************************************************
 * 功 能 : 开led
 *************************************************************************************************/
inline void led_class::led_OPEN()
{
	digitalWrite(LED_PIN, LOW);
}
/*************************************************************************************************
 * 功 能 : 关led
 *************************************************************************************************/
inline void led_class::led_CLOSE()
{
	digitalWrite(LED_PIN, HIGH);
}
/*************************************************************************************************
 * 功 能 : led 闪
 *************************************************************************************************/
inline void led_class::led_link()
{
	digitalWrite(LED_PIN, !digitalRead(LED_PIN));	 // set pin to the opposite state
}

/*************************************************************************************************
 * 功 能 : 获取led状态
 * 返 回 : 为真表示关
 *************************************************************************************************/
inline bool led_class::get_led()
{
	if(digitalRead(LED_PIN))
	{
	    return false;
	}
	else
	{
	    return true;
	}
}

/*************************************************************************************************
 * 功 能 : 外部清网络看门狗
 *************************************************************************************************/
void led_class::clean_dog_count()
{
	if(lora_even.get_server_ack())
    {
        dog_count = 0;
    }
}
/*************************************************************************************************
 * 功 能 : led显示模块
 *************************************************************************************************/
void led_class::tick()
{
	static volatile int freeheap  = 0;//内存打印
	static volatile uint8_t led_count = 0;//看看有没有跑飞
	dog_count++;
//	USE_SERIAL.printf("Memory1 : %d\r\n", freeheap);
	if(!lorawan.wifi_ok)
	{
		if(gprs.network()!=INIT_OK)
		{
			if(led_count++%1==0)
			{
				led_link();
			}
		}
		else
		{
			if(led_count++%4==0)
			{
				led_link();
			}
		}
	}
	else
	{
		led_OPEN();
	}
	clean_dog_count(); 	 
	if(dog_count==10)
	{
		if(freeheap != ESP.getFreeHeap())
		{
			freeheap = ESP.getFreeHeap();
		    USE_SERIAL.printf("Memory : %d\r\n", freeheap);
		}
	}
	if (++dog_count>(1*60*10) )//10分钟都没有消息
	{
		USE_SERIAL.print(F(" die @@@@")); 
		//修复lora GPIO 0导致 复位进入 下载模式，定时器清楚中断好了 跑飞再定时器里做
		pinMode(0, OUTPUT);
		digitalWrite(0, LOW);
		delayMicroseconds(10000);
		digitalWrite(0, HIGH);
		delayMicroseconds(10000);
		pinMode(0, INPUT_PULLUP);
		detachInterrupt(4);
		detachInterrupt(5);
		pinMode(4, OUTPUT);
		pinMode(5, OUTPUT);
		pinMode(16, OUTPUT);
		pinMode(15, OUTPUT);
		digitalWrite(4, 1);
		digitalWrite(5, 1);
		digitalWrite(2, 1);
		digitalWrite(16, 1);
		digitalWrite(15, 1);//gprs.close_pow(); 关闭电源
		while(1);//看门狗复位
	}
}

/*************************************************************************************************
 * 功 能 : 不用定时器做，防止意外中断
 *************************************************************************************************/
void led_class::led_tick()
{
//	ticker.attach_ms(1000, std::bind(&led_class::tick, this));
}
/*************************************************************************************************
 * 功 能 : 退出定时器已经无用
 *************************************************************************************************/
void led_class::exit_led_tick()
{
//	ticker.detach();
	led_OPEN();
}
/*************************************************************************************************
 * 功 能 : 升级固件显示
 *************************************************************************************************/
void led_class::uptick()
{
  static volatile uint8_t led_count = 0;//看看有没有跑飞
	if(led_count++%2==0)
	{
		led_link();
	}
}
/*************************************************************************************************
 * 功 能 : 升级固件显示
 *************************************************************************************************/
void led_class::led_upfw_tick()
{
	exit_led_tick();
	tickerup.attach_ms(50, std::bind(&led_class::uptick, this));
}
/*************************************************************************************************
 * 功 能 : 退出升级固件显示
 *************************************************************************************************/
void led_class::exit_led_uptick()
{
	tickerup.detach();
	led_OPEN();
//	led_tick();
}
/*************************************************************************************************
 * 功 能 : 进入web配置显示
 *************************************************************************************************/
void led_class::led_wps_tick()
{
	exit_led_tick();
	tickerup.attach_ms(200, std::bind(&led_class::uptick, this));
}
/*************************************************************************************************
 * 功 能 : 退出web配置显示
 *************************************************************************************************/
void led_class::exit_wps_tick()
{
	tickerup.detach();
	led_OPEN();
//	led_tick();
}
/*************************************************************************************************
 * 功 能 : led显示初始化
 *************************************************************************************************/
void led_class::start()
{
	pinMode(LED_PIN, OUTPUT);
	led_OPEN();
//	led_tick();
}
/*************************************************************************************************
 * 功 能 : led循环运行
 *************************************************************************************************/
void led_class::run()
{
	static int count = 0;
	if(count++>9999)
	{
		count = 0;
		tick();
	}
}

led_class led;

